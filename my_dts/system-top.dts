/*
 * CAUTION: This file is automatically generated by Xilinx.
 * Version: XSCT 2024.2.1
 * Today is: Sun Mar  9 13:21:24 2025
 */


/dts-v1/;
#include "pl.dtsi"
/ {
	chosen {
		bootargs = "earlycon";
		stdout-path = "serial0:9600n8";
	};
	aliases {
		i2c0 = &axi_iic_0;
		serial0 = &axi_uartlite_0;
	};
};
